## main/Kconfig.projbuild
```kconfig
menu "Camera configuration"

	config SSID
		string "WIFI access point name (SSID)"
		default "myaccesspoint"
		help
			Enter the name of the WIFI access point

	config SSID_PASSWORD
		string "WIFI password"
		default "12345678"
		help
			Enter ssid password


	config NABTO_ID
		string "Nabto ID"
		default "xxxxxxxx.yyyyy.appmyproduct.com"
		help
			Enter the Nabto id - you can get one from appmyproduct.com
		
	config NABTO_KEY
		string "Nabto key - 32 hex chars"
		default "01234567890123456789012345678912"
		help
			Enter the 32 char hex key that is for the device id

	choice CAMERA_WIRING
		prompt "Setup correct wiring of camera"
		default ESP-EYE
		help
			The different ESP32 camera modules uses different wiring for the camera.
			Please supply the correct one, or adjust the camera_config in main.c
		config ESP_EYE
			bool "ESP-EYE"
		config ESP_TINKER
			bool "Seedstudios/AI.Tinker"
	endchoice


endmenu
```
